#include <Keyboard.h>
#include <FastLED.h>
#include <SPI.h>
#include <Wire.h>
#include <Adafruit_GFX.h>
#include <Adafruit_SSD1306.h>
#include <Encoder.h>

//Setting encoders to not use interrupt pins, rotory encoder pins and positions
#define ENCODER_DO_NOT_USE_INTERRUPTS
Encoder encoder1(A0, 15);
Encoder encoder2(14, 16);
Encoder encoder3(10, 4);

//Setting LCD
#define SCREEN_WIDTH 128  // OLED display width, in pixels
#define SCREEN_HEIGHT 64  // OLED display height, in pixels
Adafruit_SSD1306 display(SCREEN_WIDTH, SCREEN_HEIGHT, &Wire, -1);
// 'Startup', 126x64px
const unsigned char epd_bitmap_Startup[] PROGMEM = {
  0x00, 0x00, 0x00, 0x00, 0x00, 0x00, 0x00, 0x00, 0x00, 0x00, 0x00, 0x00, 0x00, 0x00, 0x00, 0x00, 
	0x00, 0x00, 0x00, 0x00, 0x00, 0x00, 0x00, 0x00, 0x00, 0x00, 0x00, 0x00, 0x00, 0x00, 0x00, 0x00, 
	0x00, 0x00, 0x00, 0x00, 0x00, 0x00, 0x00, 0x00, 0x00, 0x00, 0x00, 0x00, 0x00, 0x00, 0x00, 0x00, 
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	0x00, 0x00, 0x00, 0x00, 0x00, 0x00, 0x00, 0x00, 0x00, 0x00, 0x00, 0x00, 0x00, 0x00, 0x00, 0x00
};

//Setting LED's
#define LED_PIN 9
#define NUM_LEDS 5
#define BRIGHTNESS 25
#define LED_TYPE WS2812
#define COLOR_ORDER GRB
CRGB leds[NUM_LEDS];

//Setting button matrix pins
byte inputs[] = { A1, A2, A3, 1 };
#define inCount sizeof(inputs) / sizeof(inputs[0])
byte outputs[] = { 8, 7, 6, 5 };
#define outCount sizeof(outputs) / sizeof(outputs[0])

char *macros[12] = {
  "2:   /\\_/\,0:10,2:  ( o.o ),0:10,2:   > ^ <,0:10", 
  "2:  __      _,0:10,2:o'')}____//,0:10,2: `_/      ),0:10,2: (_(_/-(_/,0:10", 
  "2:  .-.,0:10,2:/` | `\\,0:10,2:\\ /|\\ /,0:10,2: `'-'`,0:10",
  "1:128,1:120", 
  "1:128,1:99", 
  "1:128,1:118", 
  "1:131,1:225", 
  "1:131,1:226",
  "1:131,1:227",
  "1:131,1:228", 
  "1:131,1:229", 
  "1:131,1:230"
};

//Setting keypress lengths
uint8_t keyDown[outCount][inCount];

void setup() {

  //Setting up serial link
  Serial.begin(9600);
  delay(500);

  //declaring all the outputs and setting them high
  for (int i = 0; i < outCount; i++) {
    pinMode(outputs[i], OUTPUT);
    digitalWrite(outputs[i], HIGH);
  }
  //declaring all the inputs and activating the internal pullup resisto
  for (int i = 0; i < inCount; i++) {
    pinMode(inputs[i], INPUT_PULLUP);
  }

  //initializing keyboard
  Keyboard.begin();

  //initializing LEDS
  FastLED.addLeds<LED_TYPE, LED_PIN, COLOR_ORDER>(leds, NUM_LEDS);
  FastLED.setBrightness(BRIGHTNESS);
  for (int i = 0; i < NUM_LEDS; i++) {
    leds[i] = CRGB(0, 251, 255);
    FastLED.show();
  }

  //LCD
  display.begin(SSD1306_SWITCHCAPVCC, 0x3C);
  display.clearDisplay();
  display.drawBitmap(0, 0, epd_bitmap_Startup, 128, 64, WHITE);
  display.display();
  delay(2000);

}

//Main loop
void loop() {

  if (Serial.available() > 0) {
    String msg = Serial.readString();
    char str_arr[msg.length() + 1];
    msg.toCharArray(str_arr, msg.length() + 1);
    delay(1000);
    keypadFunction(str_arr);
  }

  for (int i = 0; i < outCount; i++) {

    digitalWrite(outputs[i], LOW);  //setting one row low
    delayMicroseconds(500);         //giving electronics time to settle down

    for (int j = 0; j < inCount; j++) {
      if (digitalRead(inputs[j]) == LOW) {
        keyPressed(i, j);             //calling keyPressed function if one of the inputs reads low
      } else if (keyDown[i][j] != 0)  //resetting the key if it is not pressed any more
      {
        keyDown[i][j] = 0;
      }
    }

    digitalWrite(outputs[i], HIGH);
    delayMicroseconds(500);  //setting the row high and waiting 0.5ms until next cycle
  }
  encoderPos();
}

void encoderPos() {
  uint8_t pos1 = encoder1.read();
  uint8_t pos2 = encoder2.read();
  uint8_t pos3 = encoder3.read();

  if(pos1 == 11) {
    Serial.println(F("1:1"));
  } else if(pos1 == 9) {
    Serial.println(F("1:-1"));
  }else if(pos2 == 11) {
    Serial.println(F("2:1"));
  }else if(pos2 == 9) {
    Serial.println(F("2:-1"));
  }else if(pos3 == 11) {
    Serial.println(F("3:1"));
  }else if(pos3 == 9) {
    Serial.println(F("3:-1"));
  }
  encoder1.write(10);
  encoder2.write(10);
  encoder3.write(10);
}

void keypadFunction(char *msg) {

  if (msg[0] == '1') {

    char *new_msg;
    new_msg = msg + 2;
    uint8_t button = new_msg[0] - '0';
    new_msg = strchr(msg + 2, ',');
    new_msg = new_msg + 1; 
    char *new_macro = macros[button];
    strcpy(new_macro, new_msg);
    Serial.println(button);

  } else if (msg[0] == '2') {
    
    char *token; 
    uint8_t r, g, b;
    token  = strtok(msg, ":");
    token = strtok(NULL, ",");
    r = atoi(token);
    token = strtok(NULL, ",");
    g = atoi(token);
    token = strtok(NULL, ",");
    b = atoi(token);
    
    for (int i = 0; i < NUM_LEDS; i++) {
      leds[i].setRGB(r, g, b);
      FastLED.show();
    }
  }
}

void pressmacros(int keyNumber) {

  char *macrosCopy = malloc(strlen(macros[keyNumber]) + 1);
  strcpy(macrosCopy, macros[keyNumber]);
  char delimiter[] = ",";
  char *token = strtok(macrosCopy, delimiter);

  while (token != NULL) {

    String macro = token;
    int str_len = macro.substring(2).length()+1;
    char key[str_len];
    macro.substring(2).toCharArray(key, str_len +1);
    int val = atoi(key);

    if (macro.substring(0).toInt() == 0) {
      // Converts String to ASCII character and special keys presses and releases
      Keyboard.write(val);
    } else if (macro.substring(0).toInt() == 1) {
      // Converts String to ASCII character and special keys presses and holds
      Keyboard.press(val);
    } else if (macro.substring(0).toInt() == 2) {
      //Prints text
      Keyboard.print(macro.substring(2));
    } else if (macro.substring(0).toInt() == 4) {
      Keyboard.releaseAll();
      
    } else if (macro.substring(0).toInt() == 5) {
      delay(macro.substring(2).toInt());
    }
    delay(100);
    token = strtok(NULL, delimiter);
  }
  free(macrosCopy);
  Keyboard.releaseAll();
  delay(100);
}

//if a key is pressed, this Funtion is called and outputs to serial the key location, it also sends the keystroke if not already done so
void keyPressed(uint8_t row, uint8_t col) {
  
  //if the function is called for the first time for this key
  if (keyDown[row][col] == 0) {  
    if (row == 2 && col == 3) {
      Serial.println(F("1:0"));
    } else if (row == 1 && col == 3) {
      Serial.println(F("2:0"));
    } else if (row == 0 && col == 3) {
      Serial.println(F("3:0"));
    } else {
      pressmacros((row * 3 + col + 1)-1);
    }
  }
  keyDown[row][col]++;
}