#include <SPI.h>
#include <Wire.h>
#include <Adafruit_GFX.h>
#include <Adafruit_SSD1306.h>
#include "RTClib.h"

//Setting LCD
#define SCREEN_WIDTH 128  // OLED display width, in pixels
#define SCREEN_HEIGHT 32  // OLED display height, in pixels
Adafruit_SSD1306 display(SCREEN_WIDTH, SCREEN_HEIGHT, &Wire, -1);

//Setting Animation
#define FRAME_DELAY (42)
#define FRAME_WIDTH (32)
#define FRAME_HEIGHT (32)
#define FRAME_COUNT (sizeof(frames) / sizeof(frames[0]))
uint8_t frame = 0;
const byte PROGMEM frames[][128] = {
  {0,0,0,0,0,0,0,0,0,0,0,0,0,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0,0},
  {0,0,0,0,0,0,0,0,0,0,0,0,0,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0,0},
  {0,0,0,0,0,0,0,0,0,0,0,0,0,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0,0},
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  {0,0,0,0,0,0,0,0,0,0,0,0,0,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0,0}};

//Setting RTC
RTC_DS3231 rtc;
String hour;
String min;
String sec;

void setup() {
  //initializing RTC
  if (! rtc.begin()) {
    Serial.println("Couldn't find RTC");
    Serial.flush();
    while (1) delay(10);
  }
  //rtc.adjust(DateTime(F(__DATE__), F(__TIME__)));
  hour.reserve(3);
  min.reserve(3);
  sec.reserve(3);

  display.begin(SSD1306_SWITCHCAPVCC, 0x3C);
  display.clearDisplay();
  delay(2000);

}

void loop() {
  DateTime now = rtc.now();
  hour = "";
  min = "";
  sec = "";
  if(now.twelveHour() < 10) {
    hour += "0"; 
    hour += now.twelveHour();
  }else{
    hour += now.twelveHour();
  }
  if(now.minute() < 10) {
    min += "0";
    min += now.minute();
  }else{
    min += now.minute();
  }
  if(now.second() < 10) {
    sec += "0";
    sec += now.second();
  }else{
    sec += now.second();
  }
  
  display.clearDisplay();
  display.setRotation(3);
  display.setTextSize(2);
  // Top Icon
  display.drawBitmap(0, 0, frames[frame], FRAME_WIDTH, FRAME_HEIGHT, 1);
  // Hour text
  display.setCursor(4, 40);
  display.setTextColor(SSD1306_WHITE);
  display.println(hour);
  // Coloen text
  display.setCursor(10, 55);
  display.println(":");
  // Minute Text
  display.setCursor(4, 70);
  display.println(min);
  // Colon text
  display.setCursor(10, 85);
  display.println(":");
  // Seconds text
  display.setCursor(4, 100);
  display.println(sec);

  display.display();
  frame = (frame + 1) % FRAME_COUNT;
  delay(FRAME_DELAY);

}
