#include <Keyboard.h>
#include <EncoderButton.h>
#include <FastLED.h>
#include <SPI.h>
#include <Wire.h>
#include <Adafruit_GFX.h>
#include <Adafruit_SSD1306.h>
#include <Encoder.h>

//Setting encoders to not use interrupt pins, rotory encoder pins and positions
#define ENCODER_DO_NOT_USE_INTERRUPTS
Encoder encoder1(A0, 15);
Encoder encoder2(14, 16);
Encoder encoder3(10, 4);
long enc1position = -999;
long enc1lastposition = -999;
long enc2position = -999;
long enc2lastposition = -999;
long enc3position = -999;
long enc3lastposition = -999;

//Setting LCD
#define SCREEN_WIDTH 128  // OLED display width, in pixels
#define SCREEN_HEIGHT 64  // OLED display height, in pixels
Adafruit_SSD1306 display(SCREEN_WIDTH, SCREEN_HEIGHT, &Wire, -1);
// 'Startup', 126x64px
const unsigned char epd_bitmap_Startup[] PROGMEM = {
  0x00, 0x00, 0x00, 0x00, 0x00, 0x00, 0x00, 0x00, 0x00, 0x00, 0x00, 0x00, 0x00, 0x00, 0x00, 0x00,
  0x00, 0x00, 0x00, 0x00, 0x00, 0x00, 0x00, 0x00, 0x00, 0x00, 0x00, 0x00, 0x00, 0x00, 0x00, 0x00,
  0x00, 0x00, 0x00, 0x00, 0x00, 0x00, 0x00, 0x00, 0x00, 0x00, 0x00, 0x00, 0x00, 0x00, 0x00, 0x00,
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  0x00, 0x00, 0x00, 0x00, 0x00, 0x00, 0x00, 0x00, 0x00, 0x00, 0x00, 0x00, 0x00, 0x00, 0x00, 0x00
};

//Setting LED's
#define LED_PIN 9
#define NUM_LEDS 5
#define BRIGHTNESS 25
#define LED_TYPE WS2812
#define COLOR_ORDER GRB
CRGB leds[NUM_LEDS];

//Setting button matrix pins
byte inputs[] = { A1, A2, A3, 1 };
#define inCount sizeof(inputs) / sizeof(inputs[0])
byte outputs[] = { 8, 7, 6, 5 };
#define outCount sizeof(outputs) / sizeof(outputs[0])

char *macros[12] = {
  "2:   /\\_/\,0:10,2:  ( o.o ),0:10,2:   > ^ <,0:10", 
  "2:  __      _,0:10,2:o'')}____//,0:10,2: `_/      ),0:10,2: (_(_/-(_/,0:10", 
  "2:  .-.,0:10,2:/` | `\\,0:10,2:\\ /|\\ /,0:10,2: `'-'`,0:10",
  "1:128,1:120", 
  "1:128,1:99", 
  "1:128,1:118", 
  "1:131,1:225", 
  "1:131,1:226",
  "1:131,1:227",
  "1:131,1:228", 
  "1:131,1:229", 
  "1:131,1:230"
};

//Setting keypress lengths
int keyDown[outCount][inCount];

void setup() {

  //Setting up serial link
  Serial.begin(9600);
  delay(500);

  //declaring all the outputs and setting them high
  for (int i = 0; i < outCount; i++) {
    pinMode(outputs[i], OUTPUT);
    digitalWrite(outputs[i], HIGH);
  }
  //declaring all the inputs and activating the internal pullup resisto
  for (int i = 0; i < inCount; i++) {
    pinMode(inputs[i], INPUT_PULLUP);
  }

  //initializing keyboard
  Keyboard.begin();

  //initializing LEDS
  FastLED.addLeds<LED_TYPE, LED_PIN, COLOR_ORDER>(leds, NUM_LEDS);
  FastLED.setBrightness(BRIGHTNESS);
  for (int i = 0; i < NUM_LEDS; i++) {
    leds[i] = CRGB(0, 251, 255);
    FastLED.show();
  }

  //LCD
  display.begin(SSD1306_SWITCHCAPVCC, 0x3C);
  display.clearDisplay();
  display.drawBitmap(0, 0, epd_bitmap_Startup, 128, 64, WHITE);
  display.display();
  delay(2000);

}

//Main loop
void loop() {

  if (Serial.available() > 0) {
    String msg = Serial.readString();
    delay(1000);
    keypadFunction(msg);
  }

  for (int i = 0; i < outCount; i++) {

    digitalWrite(outputs[i], LOW);  //setting one row low
    delayMicroseconds(500);         //giving electronics time to settle down

    for (int j = 0; j < inCount; j++) {
      if (digitalRead(inputs[j]) == LOW) {
        keyPressed(i, j);             //calling keyPressed function if one of the inputs reads low
      } else if (keyDown[i][j] != 0)  //resetting the key if it is not pressed any more
      {
        resetKey(i, j);
      }
    }

    digitalWrite(outputs[i], HIGH);
    delayMicroseconds(500);  //setting the row high and waiting 0.5ms until next cycle
  }
  encoder1Func();
  encoder2Func();
  encoder3Func();
}

void encoder1Func() {
  long newPos = encoder1.read();
  enc1lastposition = enc1position;
  if (newPos != enc1position) {
    enc1position = newPos;
    if (enc1lastposition > enc1position) {
      Serial.println("1:-1");
    } else {
      Serial.println("1:1");
    }
  }
}

void encoder2Func() {
  long newPos = encoder2.read();
  enc2lastposition = enc2position;
  if (newPos != enc2position) {
    enc2position = newPos;
    if (enc2lastposition > enc2position) {
      Serial.println("2:-1");
    } else {
      Serial.println("2:1");
    }
  }
}

void encoder3Func() {
  long newPos = encoder3.read();
  enc3lastposition = enc3position;
  if (newPos != enc3position) {
    enc3position = newPos;
    if (enc3lastposition > enc3position) {
      Serial.println("3:-1");
    } else {
      Serial.println("3:1");
    }
  }
}

void keypadFunction(String msg) {

  if (msg.substring(0).toInt() == 1) {
    msg = msg.substring(2);
    int sting_index  = msg.indexOf(',');
    int button = msg.substring(0,sting_index).toInt();
    int str_len = msg.substring(sting_index+1).length() + 1;

    char str_arr[str_len];
    msg.substring(sting_index+1).toCharArray(str_arr, str_len);
    char *new_macro = macros[button];
    strcpy(new_macro, str_arr);

  } else if (msg.substring(0).toInt() == 2) {
    // Split the string at the colon
    int index = msg.indexOf(':');

    // Get the index of commos
    String numbers = msg.substring(index + 2, msg.length() - 1);
    int c1 = numbers.indexOf(',');
    int c2 = numbers.indexOf(',', c1 + 1);

    // Convert sting rgb into ints
    int r = numbers.substring(0, c1).toInt();
    int g = numbers.substring(c1 + 1, c2).toInt();
    int b = numbers.substring(c2 + 1).toInt();

    for (int i = 0; i < NUM_LEDS; i++) {
      leds[i].setRGB(r, g, b);
      FastLED.show();
    }
  }
}

void pressmacros(int keyNumber) {

  char *macrosCopy = malloc(strlen(macros[keyNumber]) + 1);
  strcpy(macrosCopy, macros[keyNumber]);
  char delimiter[] = ",";
  char *token = strtok(macrosCopy, delimiter);

  while (token != NULL) {

    String macro = token;
    if (macro.substring(0).toInt() == 0) {
      // Converts String to ASCII character and special keys presses and releases
      int str_len = macro.length() + 1;
      char key[str_len];
      macro.substring(2).toCharArray(key, str_len);

      int val = atoi(key);
      Keyboard.write(val);
    } else if (macro.substring(0).toInt() == 1) {
      // Converts String to ASCII character and special keys presses and holds
      int str_len = macro.substring(2).length()+1;
      char key[str_len];
      macro.substring(2).toCharArray(key, str_len +1);

      int val = atoi(key);
      Keyboard.press(val);
    } else if (macro.substring(0).toInt() == 2) {
      //Prints text
      String key = macro.substring(2);
      Keyboard.print(key);
    } else if (macro.substring(0).toInt() == 4) {
      Keyboard.releaseAll();
    } else if (macro.substring(0).toInt() == 5) {
      int ms = macro.substring(2).toInt();
      delay(ms);
    }
    delay(100);
    token = strtok(NULL, delimiter);
  }
  free(macrosCopy);
  Keyboard.releaseAll();
  delay(200);
}

int buttonNumber(int row, int col) {
  return (row * 3 + col + 1)-1;
}

//if a key is pressed, this Funtion is called and outputs to serial the key location, it also sends the keystroke if not already done so
void keyPressed(int row, int col) {
  
  //if the function is called for the first time for this key
  if (keyDown[row][col] == 0) {  
    if (row == 2 && col == 3) {
      Serial.println("1:0");
    } else if (row == 1 && col == 3) {
      Serial.println("2:0");
    } else if (row == 0 && col == 3) {
      Serial.println("3:0");
    } else {
      int button = buttonNumber(row, col);
      pressmacros(button);
    }
  }
  keyDown[row][col]++;
}

//resetting the variables after key is released
void resetKey(int row, int col) {  

  keyDown[row][col] = 0;
}